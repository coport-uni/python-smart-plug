## docs/esp32s3/smartplugcontroller_software/main/Kconfig.projbuild
```kconfig
menu "Beszel monitor"

config BESZEL_WIFI_SSID
    string "WiFi SSID"
    default ""
    help
        WPA2-Personal SSID. Leave empty to skip WiFi bring-up; the
        Beszel tab will show a "configure WiFi" message.

config BESZEL_WIFI_PASSWORD
    string "WiFi password"
    default ""
    help
        WPA2-Personal passphrase. Stored in the local sdkconfig only.

config BESZEL_SERVER_URL
    string "Beszel base URL"
    default "http://10.16.21.197:8090"
    help
        Base URL of the Beszel/PocketBase server. Include scheme and
        port. Trailing slash optional.

config BESZEL_USER
    string "Beszel identity"
    default ""
    help
        Beszel user identity (typically the email address). Used in
        POST /api/collections/users/auth-with-password.

config BESZEL_PASSWORD
    string "Beszel password"
    default ""
    help
        Beszel user password. Stored in the local sdkconfig only.

config BESZEL_POLL_INTERVAL_S
    int "Poll interval (seconds)"
    default 5
    range 2 60
    help
        How often to poll /api/collections/systems/records.

config BESZEL_MAX_HOSTS
    int "Max hosts cached"
    default 16
    range 1 50
    help
        Upper bound on number of hosts kept in the on-device cache.

endmenu

menu "Claude usage tab"

config CLAUDE_USAGE_SERVER_URL
    string "Claude usage CSV URL"
    default "http://192.168.1.16:8765/ClaudeUsage.csv"
    help
        Full URL of the ClaudeUsage.csv file served by the host PC.
        See container/Espress_dev/claude_usage_server.py for the
        companion Python HTTP server that exposes the CSV on this
        URL.

config CLAUDE_USAGE_POLL_INTERVAL_S
    int "Poll interval (seconds)"
    default 30
    range 5 600
    help
        How often to GET the CSV. Claude usage changes slowly so
        30s is plenty; lowering it just adds traffic to the host PC.

endmenu
```

## docs/esp32s3/smartplugcontroller_software/sdkconfig.defaults
```kconfig
# 칩 타깃
CONFIG_IDF_TARGET="esp32s3"

# 16MB 플래시
CONFIG_ESPTOOLPY_FLASHSIZE_16MB=y
CONFIG_ESPTOOLPY_FLASHSIZE="16MB"
CONFIG_PARTITION_TABLE_SINGLE_APP_LARGE=y

# Octal PSRAM (BOX-3는 16MB Octal)
CONFIG_SPIRAM=y
CONFIG_SPIRAM_MODE_OCT=y
CONFIG_SPIRAM_SPEED_80M=y
CONFIG_SPIRAM_USE_MALLOC=y

# CPU 클럭 240MHz
CONFIG_ESP_DEFAULT_CPU_FREQ_MHZ_240=y

# LVGL 더블 버퍼링용 메모리
CONFIG_LV_MEM_CUSTOM=y
CONFIG_LV_MEMCPY_MEMSET_STD=y

# LVGL 내장 sprintf에서 %f 지원. 없으면 lv_label_set_text_fmt("%f", x)가 'f' literal로 출력됨.
CONFIG_LV_USE_FLOAT=y

# USB-Serial JTAG 콘솔
CONFIG_ESP_CONSOLE_USB_SERIAL_JTAG=y
```
